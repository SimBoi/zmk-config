## config/boards/shields/oh31/Kconfig.defconfig
```kconfig
if SHIELD_OH31

config ZMK_KEYBOARD_NAME
    default "oh31"

endif # SHIELD_OH31

if ZMK_DISPLAY

config I2C
    default y

config SSD1306
    default y

endif # ZMK_DISPLAY
```
